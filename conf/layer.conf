## conf/layer.conf
```bitbake
# We have a conf and classes directory, add to BBPATH
BBPATH .= ":${LAYERDIR}"

# We have recipes-* directories, add to BBFILES
BBFILES += "${LAYERDIR}/recipes-*/*/*.bb \
            ${LAYERDIR}/recipes-*/*/*.bbappend"

BBFILE_COLLECTIONS += "meta-maptattoo"
BBFILE_PATTERN_meta-maptattoo = "^${LAYERDIR}/"
BBFILE_PRIORITY_meta-maptattoo = "6"

LAYERDEPENDS_meta-maptattoo = "core"
LAYERSERIES_COMPAT_meta-maptattoo = "kirkstone"
```
